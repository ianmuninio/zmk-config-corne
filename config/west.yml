## config/west.yml
```yaml
manifest:
  remotes:
    - name: zmkfirmware
      url-base: https://github.com/zmkfirmware
    - name: ianmuninio
      url-base: https://github.com/ianmuninio
  projects:
    - name: zmk
      remote: ianmuninio
      revision: main
      import: app/west.yml
  self:
    path: config
```
